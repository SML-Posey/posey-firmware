## boards/arm/sml_poseyh1_nrf52832/Kconfig.board
```kconfig
config BOARD_SML_POSEYH1_NRF52832
	bool "SML Posey-h1"
	depends on SOC_NRF52832_QFAA
```

## boards/arm/sml_poseyh1_nrf52832/Kconfig.defconfig
```kconfig
if BOARD_SML_POSEYH1_NRF52832

config BOARD
	default "sml_poseyh1_nrf52832"

config BT_CTLR
   default BT

endif
```

## boards/arm/sml_poseyh2310_nrf5340/Kconfig.board
```kconfig
if SOC_NRF5340_CPUAPP_QKAA

config BOARD_SML_POSEYH2310_NRF5340_CPUAPP
	bool "SML Posey-h2310 Application MCU"

config BOARD_SML_POSEYH2310_NRF5340_CPUAPP_NS
	bool "SML Posey-h2310 Application MCU non-secure"

endif

config BOARD_SML_POSEYH2310_NRF5340_CPUNET
	bool "SML Posey-h2310 Network MCU"
	depends on SOC_NRF5340_CPUNET_QKAA
```

## boards/arm/sml_poseyh2310_nrf5340/sml_poseyw2310_nrf5340_cpunet_defconfig
```kconfig
CONFIG_SOC_SERIES_NRF53X=y
CONFIG_SOC_NRF5340_CPUNET_QKAA=y
CONFIG_BOARD_SML_POSEYW2310_NRF5340_CPUNET=y

# External XTAL
CONFIG_CLOCK_CONTROL_NRF_K32SRC_XTAL=y
CONFIG_CLOCK_CONTROL_NRF_K32SRC_500PPM=y

# Enable hardware stack protection
CONFIG_HW_STACK_PROTECTION=y

# Enable MPU
CONFIG_ARM_MPU=y

# Enable peripherals.
CONFIG_GPIO=y

CONFIG_PINCTRL=y
```

## boards/arm/sml_poseyr2310_nrf52832/Kconfig.board
```kconfig
config BOARD_SML_POSEYR2310_NRF52832
	bool "SML Posey-r2310"
	depends on SOC_NRF52832_QFAA
```

## boards/arm/sml_poseyr2310_nrf52832/Kconfig.defconfig
```kconfig
if BOARD_SML_POSEYR2310_NRF52832

config BOARD
	default "sml_poseyr2310_nrf52832"

config BT_CTLR
   default BT

endif
```

## boards/arm/sml_poseyr2405_nrf52832/Kconfig.board
```kconfig
config BOARD_SML_POSEYR2405_NRF52832
	bool "SML Posey-r2405"
	depends on SOC_NRF52832_QFAA
```

## boards/arm/sml_poseyr2405_nrf52832/Kconfig.defconfig
```kconfig
if BOARD_SML_POSEYR2405_NRF52832

config BOARD
	default "sml_poseyr2405_nrf52832"

config BT_CTLR
   default BT

endif
```

## boards/arm/sml_poseyr2405_nrf52832/sml_poseyr2405_nrf52832_defconfig
```kconfig
CONFIG_SOC_SERIES_NRF52X=y
CONFIG_SOC_NRF52832_QFAA=y
CONFIG_BOARD_SML_POSEYR2405_NRF52832=y

# Enable MPU
CONFIG_ARM_MPU=y

# External XTAL
CONFIG_CLOCK_CONTROL_NRF_K32SRC_XTAL=y
CONFIG_CLOCK_CONTROL_NRF_K32SRC_250PPM=y

# Enable hardware stack protection
CONFIG_HW_STACK_PROTECTION=y

# Enable peripherals.
CONFIG_GPIO=y
CONFIG_SERIAL=n
CONFIG_I2C=y
CONFIG_SPI=n
CONFIG_SENSOR=y
CONFIG_BNO08x=y
CONFIG_ADC=y
CONFIG_PINCTRL=y

# additional board options
# CONFIG_GPIO_AS_PINRESET=y
```

## boards/arm/sml_poseyr2_nrf52832/Kconfig.board
```kconfig
config BOARD_SML_POSEYR2_NRF52832
	bool "SML Posey-r2"
	depends on SOC_NRF52832_QFAA
```

## boards/arm/sml_poseyr2_nrf52832/Kconfig.defconfig
```kconfig
if BOARD_SML_POSEYR2_NRF52832

config BOARD
	default "sml_poseyr2_nrf52832"

config BT_CTLR
   default BT

endif
```

## boards/arm/sml_poseyv6_nrf52832/Kconfig.board
```kconfig
config BOARD_SML_POSEYV6_NRF52832
	bool "SML Posey-v6"
	depends on SOC_NRF52832_QFAA
```

## boards/arm/sml_poseyv6_nrf52832/Kconfig.defconfig
```kconfig
if BOARD_SML_POSEYV6_NRF52832

config BOARD
	default "sml_poseyv6_nrf52832"

config BT_CTLR
   default BT

endif
```

## boards/arm/sml_poseyv6_nrf52832/sml_poseyv6_nrf52832_defconfig
```kconfig
CONFIG_SOC_SERIES_NRF52X=y
CONFIG_SOC_NRF52832_QFAA=y
CONFIG_BOARD_SML_POSEYV6_NRF52832=y

# Enable MPU
CONFIG_ARM_MPU=y

# enable uart driver
CONFIG_SERIAL=y

# enable console
CONFIG_CONSOLE=y
CONFIG_UART_CONSOLE=y

# Enable hardware stack protection
CONFIG_HW_STACK_PROTECTION=y

# Enable RTT
CONFIG_USE_SEGGER_RTT=y

# enable GPIO
CONFIG_GPIO=y

# additional board options
CONFIG_GPIO_AS_PINRESET=y
```

## boards/arm/sml_poseyw2310_nrf52840/Kconfig.board
```kconfig
config BOARD_SML_POSEYW2310_NRF52840
	bool "SML Posey-w2310"
	depends on SOC_NRF52840_QIAA
```

## boards/arm/sml_poseyw2310_nrf52840/Kconfig.defconfig
```kconfig
if BOARD_SML_POSEYW2310_NRF52840

config BOARD
	default "sml_poseyw2310_nrf52840"

config BT_CTLR
   default BT

endif
```

## boards/arm/sml_poseyw2310_nrf52840/sml_poseyw2310_nrf52840_defconfig
```kconfig
CONFIG_SOC_SERIES_NRF52X=y
# should be CKAA, but not available yet from Nordic Semiconductor
CONFIG_SOC_NRF52840_QIAA=y
CONFIG_BOARD_SML_POSEYW2310_NRF52840=y

# External XTAL
CONFIG_CLOCK_CONTROL_NRF_K32SRC_XTAL=y
CONFIG_CLOCK_CONTROL_NRF_K32SRC_500PPM=y

# Enable hardware stack protection
CONFIG_HW_STACK_PROTECTION=y

# Enable MPU
CONFIG_ARM_MPU=y

# Enable RTT
CONFIG_USE_SEGGER_RTT=y

# Enable peripherals.
CONFIG_GPIO=y
CONFIG_I2C=y
CONFIG_SENSOR=y
CONFIG_BNO08x=y
CONFIG_ADC=y

# additional board options
CONFIG_GPIO_AS_PINRESET=y

CONFIG_PINCTRL=y
```

## drivers/sensor/bno08x/Kconfig
```kconfig
menuconfig BNO08x
	bool "BNO08x I2C/SPI IMU"
	depends on I2C || SPI
	help
	  Enable driver for BNO08x IMU.
```

## drivers/sensors/ceva/bno08x/Kconfig
```kconfig
menuconfig BNO08X
	bool "BNO080/5/6 IMU"
	depends on SPI
	help
	  Enable driver for BNO080/5/6 IMU sensor. The CEVA SH2 interface is to be used
	  directly, since translating that to Zephyr's sensor API would be cumbersom and
	  inefficient. The driver only implements the SPI bus at this time.

if BNO08X

config BNO08X_BUS_SPI
	bool "BNO08X driver support for SPI bus"
	default y
	depends on $(dt_compat_on_bus,$(DT_COMPAT_CEVA_BNO08X),spi)
	select SPI

endif # BNO08X
```
